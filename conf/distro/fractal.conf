## conf/layer.conf
```bitbake
BBPATH .= ":${LAYERDIR}"
BBFILES += "${LAYERDIR}/recipes-*/*/*.bb ${LAYERDIR}/recipes-*/*/*.bbappend"
BBFILE_COLLECTIONS += "fractal"
BBFILE_PATTERN_fractal = "^${LAYERDIR}/"
BBFILE_PRIORITY_fractal = "20"
LAYERSERIES_COMPAT_fractal = "wrynose"
LAYERDEPENDS_fractal = "core virtualization-layer"
```

## conf/machine/fractal-x86-64.conf
```bitbake
DEFAULTTUNE = "core2-64"
require conf/machine/include/x86/tune-core2.inc
MACHINE_FEATURES = "acpi pci usbhost"
PREFERRED_PROVIDER_virtual/kernel = "linux-fractal-cip"
KERNEL_IMAGETYPE = "bzImage"
KERNEL_ARCH = "x86"
SERIAL_CONSOLES = ""
MACHINE_ESSENTIAL_EXTRA_RDEPENDS = ""
MACHINE_EXTRA_RRECOMMENDS = ""
```
